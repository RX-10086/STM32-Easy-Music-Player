RCC_BASE EQU 0x40023800
RCC_AHB1ENR	EQU	(RCC_BASE+0x30)
RCC_AHB1Periph_GPIOE_GPIOF    EQU	0x00000030
	;0x00000020
GPIOF	EQU	0x40021400
GPIOF_BSRR	EQU	(GPIOF+0x18)      ;端口置位/复位    
GPIOF_MODER	EQU (GPIOF+0x00)  ;工作模式
GPIOF_OTYPER	EQU	(GPIOF+0x04)   ;输出类型
GPIOF_OSPEEDR	EQU	(GPIOF+0x08)   ;输出速度 
GPIOF_ODR	EQU	(GPIOF+0x14)    ;输出
LED_OFF EQU   (0x00000700)

GPIOE	EQU	0x40021000
GPIOE_BSRR	EQU	(GPIOE+0x18)
GPIOE_MODER	EQU (GPIOE+0x00)
GPIOE_OSPEEDR	EQU (GPIOE+0x08)
GPIOE_IDR	EQU	(GPIOE+0x10)    ;输入
GPIOE_PUPDR	EQU	(GPIOE+0x0c)    ;上拉/下拉


	IMPORT Delay_Init       ;延时初始化,无参数
	IMPORT Delay_Ms       ;毫秒延时,参数在R0
	IMPORT Delay_Us       ;微秒延时,参数在R0
	EXPORT GPIO_INIT     ;GPIO初始化
	EXPORT GPIOF_8_ON
	EXPORT GPIOF_9_ON
	EXPORT GPIOF_10_ON
	EXPORT GPIOF_OFF
	EXPORT GPIOE_READ    ;读取PE3的电平,结果返回R0
		
		
	AREA ||i.GPIO_INIT||, CODE, READONLY, ALIGN=2
	
GPIO_INIT PROC
	;GPIOE GPIOF时钟使能
	LDR	R1,=RCC_AHB1ENR
	LDR	R0,[R1]
	LDR	R2,=RCC_AHB1Periph_GPIOE_GPIOF
	ORR	R0,R2
	STR R0,[R1]
	;将PF8、9、10设置为推挽输出
	LDR	R2,=GPIOF_BSRR
	LDR R0,=LED_OFF
	STR R0,[R2]
	LDR R0,=0x00150000
	LDR	R1,=GPIOF_MODER
	STR R0,[R1]
	LDR R0,=0x00000000
	LDR R1,=GPIOF_OTYPER
	STR R0,[R1]
	LDR R0,=0x003f0000
	LDR R1,=GPIOF_OSPEEDR
	STR R0,[R1]
	;GPIOF全部置低电平
	LDR R0,=0xFFFFFFFF
	LDR R1,=GPIOF_ODR
	STR R0,[R1]
	
	LDR R0,=0x00000000
	LDR	R1,=GPIOE_MODER
	STR R0,[R1]
	LDR R0,=0x000003f0
	LDR	R1,=GPIOE_OSPEEDR
	STR R0,[R1]
	;PE2、3、4全部置为上拉输入
	LDR R0,=0x00000150
	LDR	R1,=GPIOE_PUPDR
	STR R0,[R1]
	
	BX LR
	ENDP
		
	AREA ||i.GPIOF_8_ON||, CODE, READONLY, ALIGN=2
		
GPIOF_8_ON PROC
	;PF8输出高电平，其他GPIOF为低
	LDR R0,=0xFFFFFEFF
	LDR R1,=GPIOF_ODR
	STR R0,[R1]
	BX LR
	ENDP

	AREA ||i.GPIOF_9_ON||, CODE, READONLY, ALIGN=2
		
GPIOF_9_ON PROC
	;PF9输出高电平，其他GPIOF为低
	LDR R0,=0xFFFFFDFF
	LDR R1,=GPIOF_ODR
	STR R0,[R1]
	BX LR
	ENDP
		
	AREA ||i.GPIOF_10_ON||, CODE, READONLY, ALIGN=2
		
GPIOF_10_ON PROC
	;PF10输出高电平，其他GPIOF为低
	LDR R0,=0xFFFFFBFF
	LDR R1,=GPIOF_ODR
	STR R0,[R1]
	BX LR
	ENDP
		
	AREA ||i.GPIOF_OFF||, CODE, READONLY, ALIGN=2
	
GPIOF_OFF PROC
	;全部GPIOF接口为低
	LDR R0,=0xFFFFFFFF
	LDR R1,=GPIOF_ODR
	STR R0,[R1]
	BX LR
	ENDP
		
	AREA ||i.GPIOE_READ||, CODE, READONLY, ALIGN=2
		
GPIOE_READ PROC
	;检测PE3输入是否低电平
	LDR R1,=GPIOE_IDR
	LDR R0, [R1]
	LSR R0, R0, #3         ;寄存器位移
	LSL R0, R0, #31
	LSR R0, R0, #31
	BX LR
	ENDP

	END